## boards/xtensa/adafruit_huzzah32/Kconfig.board
```kconfig
# Copyright (c) 2022 Chris Wilson <christopher.david.wilson@gmail.com>
# SPDX-License-Identifier: Apache-2.0

config BOARD_ADAFRUIT_HUZZAH32
	bool "Adafruit HUZZAH32 Board"
	depends on SOC_ESP32
```

## boards/xtensa/adafruit_huzzah32/Kconfig.defconfig
```kconfig
# ESP32 board configuration

# Copyright (c) 2017 Intel Corporation
# SPDX-License-Identifier: Apache-2.0

config BOARD
	default "adafruit_huzzah32"
	depends on BOARD_ADAFRUIT_HUZZAH32

if BT

config HEAP_MEM_POOL_SIZE
	default 16384

config ENTROPY_GENERATOR
	default y

choice BT_HCI_BUS_TYPE
	default BT_ESP32
endchoice

endif # BT
```
